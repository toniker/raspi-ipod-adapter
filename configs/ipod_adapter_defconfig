## package/ipod-gadget/Config.in
```kconfig
config BR2_PACKAGE_IPOD_GADGET
	bool "ipod-gadget"
	depends on BR2_LINUX_KERNEL
	help
	  Out-of-tree Linux USB gadget kernel modules that make the board
	  enumerate to a host (a car head unit, a dock) as an Apple iPod:
	  a USB Audio Class 1 streaming interface plus a HID interface that
	  carries iAP (iPod Accessory Protocol) packets on a /dev/iap0
	  character device.

	  Builds three modules, loaded in this order:
	    g_ipod_audio  - creates the "iPodUSB" ALSA playback card
	    g_ipod_hid    - HID transport for iAP
	    g_ipod_gadget - the composite device tying them together

	  The matching userspace iAP client is the separate "ipod" package.

	  https://github.com/oandrew/ipod-gadget

comment "ipod-gadget needs a Linux kernel to be built"
	depends on !BR2_LINUX_KERNEL
```

## package/ipod/Config.in
```kconfig
config BR2_PACKAGE_IPOD
	bool "ipod"
	depends on BR2_PACKAGE_HOST_GO_TARGET_ARCH_SUPPORTS
	depends on BR2_TOOLCHAIN_HAS_THREADS
	help
	  Go userspace implementation of the iPod Accessory Protocol (iAP).
	  Runs as `ipod serve /dev/iap0`: it speaks iAP to the car head unit
	  over the HID character device created by the ipod-gadget kernel
	  modules, completes the identify/handshake, and starts the audio
	  session so the "iPodUSB" ALSA card can play.

	  This is the upstream oandrew/ipod, the matching client for the
	  oandrew/ipod-gadget modules. Metadata is static; AVRCP/D-Bus
	  metadata passthrough would be a later change.

	  https://github.com/oandrew/ipod

comment "ipod needs a toolchain w/ threads, and a Go-capable architecture"
	depends on !BR2_PACKAGE_HOST_GO_TARGET_ARCH_SUPPORTS || \
		!BR2_TOOLCHAIN_HAS_THREADS
```
